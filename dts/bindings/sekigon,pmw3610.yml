## dts/bindings/sekigon,pmw3610.yml
```yaml
description: |
  Sensor driver for the pixart PMW3610 mouse sensor 

compatible: "sekigon,pmw3610"

include: spi-device.yaml

properties:
  irq-gpios:
    type: phandle-array
    required: true
  power-gpios:
    type: phandle-array
    required: false
  scroll-layers:
    type: array
    default: []
  snipe-layers:
    type: array
    default: []
  automouse-layer:
    type: int
    default: -1
```
